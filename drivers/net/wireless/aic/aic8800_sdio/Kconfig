## drivers/net/wireless/aic/aic8800_sdio/Kconfig
```kconfig
config AIC_WLAN_AIC8800_SDIO
	bool "AIC8800 SDIO Support"
	default n
	help
	  This is support for aic wireless chip.

if AIC_WLAN_AIC8800_SDIO
source "drivers/net/wireless/aic/aic8800_sdio/aic8800_fdrv/Kconfig"
source "drivers/net/wireless/aic/aic8800_sdio/aic8800_btlpm/Kconfig"
endif
```

## ubuntu/media-i2c-it6510/Kconfig
```kconfig
config VIDEO_IT6510
	tristate "IT6510 bridge ic sample driver"
	help
	  This driver is base on IT6510 sample driver from ITE. It is
	  forward porting from kernel 5.10 to kernel 5.15.

	  Enable IT6510 demo kit receive DP signal and divide into video
	  and audio. This driver supports audio signal output as i2s format
	  from IT6510 SoC and connect to mt8395, output the sound from jack.
```

## ubuntu/mtk-camisp-driver-dkms/drivers/media/platform/mtk-isp/Kconfig
```kconfig
config VIDEO_MTK_ISP_7_CAMSYS
	tristate "MediaTek ISP7x camsys driver"
	depends on VIDEO_V4L2
	depends on ARCH_MEDIATEK
	select V4L2_FWNODE
	select VIDEO_V4L2_SUBDEV_API
	select VIDEOBUF2_VMALLOC
	select VIDEOBUF2_DMA_CONTIG
	select RPMSG_MTK_CCD
	select MTKCCD_REMOTEPROC
	select MTK_SCP

	default n
	help
		Camsys driver controls 3A (auto-focus, exposure,
		and white balance) with tuning feature and outputs
		the captured image buffers in MediaTek's ISP7x system.

		Choose y if you want to use MediaTek SoCs to create image
		captured application such as video recording and still image
		capturing.

config VIDEO_MTK_ISP_7_IMGSYS
	tristate "MediaTek ISP7x image processing system function"
	depends on MTK_CMDQ
	depends on REMOTEPROC
	select VIDEO_V4L2_SUBDEV_API
	select VIDEOBUF2_DMA_CONTIG
	select VIDEOBUF2_CORE
	select VIDEOBUF2_V4L2
	select VIDEOBUF2_MEMOPS
	select MEDIA_CONTROLLER

	default n
	help
	    Support the basic Image processing system driver.

	    IMGSYS driver provides image format conversion, resizing,
	    and rotation function through the low power hardware.
	    IMGSYS also supports multiple output feature. It can
	    generate two or more output image with different effect
	    based on a single input image at the same time.
```

## ubuntu/mtk-fsource-driver/Kconfig
```kconfig
config MTK_FSOURCE
	tristate "MediaTek Fsource Support"
	depends on MFD_MT6397
	help
	  If you say yes to this option, support will be included for the
	  built-in MTK PMIC chips.

	  Say m here if you want to include fsource support as a module. This
	  will build a module called "mtk-fsource".
```
